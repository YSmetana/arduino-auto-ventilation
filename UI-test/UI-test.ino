// For proper text align.
#define DISPLAY_WIDTH 128
#define DISPLAY_HEIGH 64

#define BLINK_DUR 500UL

#include <U8g2lib.h>

// OLED 0.96" I2C 128x64, https://arduino.ua/prod1263-oled-displei-modyl-belii
//U8G2_SSD1306_128X64_NONAME_1_HW_I2C u8g2(U8G2_R0, /* reset=*/ U8X8_PIN_NONE);
U8G2_SSD1306_128X64_NONAME_F_HW_I2C u8g2(U8G2_R0, /* reset=*/ U8X8_PIN_NONE); // full buffer

// Weather icons by Zlatko Najdenovski, https://www.iconfinder.com/zlaten .

#define temperature_width 32
#define temperature_height 32
static const unsigned char temperature_bits[] PROGMEM = {
   0x00, 0xf8, 0x07, 0x00, 0x00, 0x3c, 0x07, 0x00, 0x00, 0x0c, 0x0e, 0x00,
   0x00, 0x0e, 0x0e, 0x00, 0x00, 0x0e, 0x0e, 0x00, 0x00, 0x0e, 0x0e, 0x00,
   0x00, 0x0e, 0x0e, 0x00, 0x00, 0x0e, 0x0e, 0x00, 0x00, 0x0e, 0x0e, 0x00,
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   0x00, 0xe0, 0x00, 0x00, 0x00, 0x00, 0x00, 0x00 };

#define humidity_32_width 32
#define humidity_32_height 32
static const unsigned char humidity_32_bits[] PROGMEM = {
   0x00, 0x00, 0x00, 0x00, 0x00, 0x00, 0x80, 0x01, 0x00, 0x00, 0xc0, 0x03,
   0x00, 0x00, 0xf0, 0x07, 0x00, 0x00, 0x78, 0x0f, 0x00, 0x00, 0x38, 0x1c,
   0x00, 0x00, 0x1c, 0x3c, 0x00, 0x00, 0x1e, 0x38, 0x00, 0x00, 0x0e, 0x70,
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   0xf8, 0x1f, 0x00, 0x00, 0xe0, 0x07, 0x00, 0x00 };

#define pressure_32_width 32
#define pressure_32_height 32
static const unsigned char pressure_32_bits[] PROGMEM = {
   0x00, 0xf0, 0x0f, 0x00, 0x00, 0xfe, 0x7f, 0x00, 0x80, 0xff, 0xff, 0x01,
   0xc0, 0x87, 0xf1, 0x03, 0xe0, 0x81, 0x81, 0x07, 0xf0, 0x00, 0x00, 0x0f,
   0x78, 0x00, 0x00, 0x1e, 0x3c, 0x00, 0x00, 0x3c, 0x1c, 0x00, 0x00, 0x38,
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   0x00, 0xfe, 0x7f, 0x00, 0x00, 0xf0, 0x0f, 0x00 };

#define home_inside_width 16
#define home_inside_height 16
static const unsigned char home_inside_bits[] PROGMEM = {
   0x00, 0x00, 0x80, 0x01, 0x40, 0x02, 0x20, 0x04, 0x10, 0x08, 0x08, 0x10,
   0x04, 0x20, 0x06, 0x60, 0x04, 0x20, 0x04, 0x20, 0xe4, 0x20, 0xe4, 0x20,
   0xe4, 0x20, 0x04, 0x20, 0x04, 0x20, 0xfc, 0x3f };

#define home_outside_width 16
#define home_outside_height 16
static const unsigned char home_outside_bits[] PROGMEM = {
   0x00, 0xe0, 0x80, 0xe1, 0x40, 0xe2, 0x20, 0x04, 0x10, 0x08, 0x08, 0x10,
   0x04, 0x20, 0x06, 0x60, 0x04, 0x20, 0x04, 0x20, 0x04, 0x20, 0x04, 0x20,
   0x04, 0x20, 0x04, 0x20, 0x04, 0x20, 0xfc, 0x3f };

#define fan_8_width 8
#define fan_8_height 8
static const unsigned char fan_8_bits[] PROGMEM = {
   0x0e, 0x8c, 0xd8, 0xe4, 0x27, 0x1b, 0x31, 0x70 };

#define arrow_inside_8_width 8
#define arrow_inside_8_height 8
static const unsigned char arrow_inside_8_bits[] PROGMEM = {
   0x00, 0x00, 0x00, 0x78, 0x18, 0x28, 0x48, 0x80 };

#define arrow_outside_8_width 8
#define arrow_outside_8_height 8
static const unsigned char arrow_outside_8_bits[] PROGMEM = {
   0xf0, 0xc0, 0xa0, 0x90, 0x08, 0x00, 0x00, 0x00 };

#define blow_width 16
#define blow_height 16
static const unsigned char blow_bits[] PROGMEM = {
   0x00, 0x00, 0x00, 0x1e, 0x00, 0x32, 0x00, 0x22, 0x00, 0x30, 0xff, 0x1f,
   0x00, 0x00, 0xff, 0x7f, 0x00, 0xc0, 0xff, 0x89, 0x00, 0xdb, 0x20, 0x72,
   0x60, 0x03, 0xc0, 0x01, 0x00, 0x00, 0x00, 0x00 };

unsigned int center_x(char* message, int margin_left=0, int margin_right=0);
unsigned int right_x(char* message, int margin_right=0);
void blink_fan();

void pageTemperature(); // Page-1
void pageHumidity();    // Page-2
void pagePressure();    // Page-3
void pageTimeDay();     // Page-4

//unsigned int pageCount = 4;
int current_page = 0;
void (*pages[])() = {pageTemperature, pageHumidity, pagePressure, pageTimeDay};
unsigned int pages_count = 4;
int page_duration[] = {3000UL, 3000UL, 3000UL, 1000UL};

unsigned long TimerA = millis();
unsigned long TimerB = millis();

void setup(void) {
  Serial.begin(9600);

  u8g2.begin();
  u8g2.setColorIndex(1);
  u8g2.setFontMode(0);		// enable transparent mode, which is faster
}

void loop() {
  u8g2.clearBuffer();
  blink_fan();
  (*pages[current_page])();
  u8g2.sendBuffer();

  if (millis()-TimerA >= page_duration[current_page]) {
    current_page++;
    if (current_page > pages_count-1)
      current_page=0;

    TimerA = millis();
  }
}

void pageTemperature(){
  char outside_temp[] = "+27.8";
  char inside_temp[] = "-15.2";

  u8g2.drawXBMP( 0, 16, temperature_width, temperature_height, temperature_bits);

  u8g2.setFont(u8g2_font_logisoso24_tn);
  u8g2.drawStr( right_x(outside_temp,32), 26, outside_temp);
  u8g2.drawStr( right_x(inside_temp,32), 62, inside_temp);

  u8g2.setFont(u8g2_font_pxplusibmvga8_mf);
  u8g2.drawUTF8(104, 36, "°C");

  u8g2.drawXBMP( 120, 0, arrow_outside_8_width, arrow_outside_8_height, arrow_outside_8_bits);
  u8g2.drawXBMP( 120, 56, arrow_inside_8_width, arrow_inside_8_height, arrow_inside_8_bits);
  return 0;
}
void pageHumidity() {
  char outside_hum[] = "72";
  char inside_hum[] = "45";

  u8g2.drawXBMP( 0, 16, humidity_32_width, humidity_32_height, humidity_32_bits);

  u8g2.setFont(u8g2_font_logisoso24_tr);
  u8g2.drawStr(right_x(outside_hum, 32), 26, outside_hum);
  u8g2.drawStr(right_x(inside_hum, 32), 64, inside_hum);


  u8g2.setFont(u8g2_font_pxplusibmvga8_mf);
  u8g2.drawUTF8(104, 36, "%");

  u8g2.drawXBMP( 120, 0, arrow_outside_8_width, arrow_outside_8_height, arrow_outside_8_bits);
  u8g2.drawXBMP( 120, 56, arrow_inside_8_width, arrow_inside_8_height, arrow_inside_8_bits);
  return 0;
}

void pagePressure() {
  char outside_press[] = "760";
  char inside_press[] = "765";

  u8g2.drawXBMP( 0, 16, pressure_32_width, pressure_32_height, pressure_32_bits);

  u8g2.setFont(u8g2_font_logisoso24_tn);

  u8g2.drawStr(right_x(outside_press, 32), 24, outside_press);
  u8g2.drawStr(right_x(inside_press, 32), 64, inside_press);

  u8g2.setFont(u8g2_font_pxplusibmvga8_mf);
  u8g2.drawUTF8(104, 28, "mm");
  u8g2.drawUTF8(104, 44, "Hg");

  u8g2.drawXBMP( 120, 0, arrow_outside_8_width, arrow_outside_8_height, arrow_outside_8_bits);
  u8g2.drawXBMP( 120, 56, arrow_inside_8_width, arrow_inside_8_height, arrow_inside_8_bits);
  return 0;
}

void pageTimeDay() {
  char time_now[] = "08:48";
  char date_now[] = "22.07.18";

  u8g2.setFont(u8g2_font_inb30_mn);
  u8g2.drawStr( center_x(time_now), 40, time_now);

  u8g2.setFont(u8g2_font_pxplusibmvga8_mf);
  u8g2.drawUTF8(center_x(date_now), 64, date_now);
  return 0;
}

unsigned int center_x(char* message, int margin_left=0, int margin_right=0) {
  /*
   * Centers the string.
   */
  return (DISPLAY_WIDTH-margin_left-margin_right-u8g2.getStrWidth(message))/2+margin_left;
}

unsigned int right_x(char* message, int margin_right=0) {
  return DISPLAY_WIDTH-margin_right-u8g2.getStrWidth(message);
}

void blink_fan() {
  /*
   * Blink fan icon.
   */
  if (millis()-TimerB < BLINK_DUR) {
    u8g2.drawXBMP( 0, 0, fan_8_width, fan_8_height, fan_8_bits);
  }
  if (millis()-TimerB >= BLINK_DUR && millis()-TimerB < BLINK_DUR*2) {
    //u8g2.drawXBMP( 0, 0, fan_8_width, fan_8_height, fan_8_bits);
  }

  if (millis()-TimerB >= BLINK_DUR*2) {
    TimerB = millis();
  }
  return 0;
}
